/*********************************************************************************************************
**
**                                    中国软件开源组织
**
**                                   嵌入式实时操作系统
**
**                                       SylixOS(TM)
**
**                               Copyright  All Rights Reserved
**
**--------------文件信息--------------------------------------------------------------------------------
**
** 文   件   名: config.ld
**
** 创   建   人: RealEvo-IDE
**
** 文件创建日期: 2015 年11 月30 日
**
** 描        述: 本文件由 RealEvo-IDE 生成，请勿手动修改
*********************************************************************************************************/

/*********************************************************************************************************
    内存布局定义
*********************************************************************************************************/

MEMORY
{
  ROM (rx) : ORIGIN = 0xBFC00000, LENGTH = (12 * 1024 * 1024)
  RAM (rw) : ORIGIN = 0x80200000, LENGTH = (49 * 1024 * 1024)
}

/*********************************************************************************************************
    BSP 常量定义
*********************************************************************************************************/

SYLIXOS_DATA_START = 0x80800000;

/*********************************************************************************************************
  END
*********************************************************************************************************/
